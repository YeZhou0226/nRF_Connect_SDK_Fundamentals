## CMakeLists.txt
```
cmake_minimum_required(VERSION 3.20.0)
find_package(Zephyr REQUIRED HINTS $ENV{ZEPHYR_BASE})
project(hello_world)
target_sources(app PRIVATE src/main.c)
target_sources(app PRIVATE src/myfunction.c)
target_sources_ifdef(CONFIG_MYFUNCTION app PRIVATE src/myfunction.c)
```

## prj.conf
```kconfig
CONFIG_MYFUNCTION=y
```

## src/main.c
```c
#include <zephyr/kernel.h>
#include <zephyr/sys/printk.h>
#include "myfunction.h"

void main(void)
{
	int a = 3, b = 4;
	while(1){
		if(!(IS_ENABLED(CONFIG_MYFUNCTION))){
			printk("MYFUNCTION not enabled\r\n");
			return;
		}
		printk("The sum of %d and %d is %d\n\r", a, b, sum(a,b));
		k_msleep(1000);
	}
}
```
